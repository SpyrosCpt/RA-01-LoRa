#include "Preprocessor.h"

//Font created from the Squix font converter found at https://oleddisplay.squix.ch/#/home
//Currently only fonts that take up 2 rows are supported (size 12 is a good size)
//Replace number of chars with 0x60 not 0xE0 if you only want ascii characters from 32 - 127
//current font is Dialog size 12
const UI8 CurrentFont[] = 
{
	0x0B, // Width: 11
	0x0F, // Height: 15
	0x20, // First Char: 32
	0x60, // Numbers of Chars: 96 

	// Jump Table:
	0xFF, 0xFF, 0x00, 0x04,  // 32:65535
	0x00, 0x00, 0x06, 0x05,  // 33:0
	0x00, 0x06, 0x07, 0x05,  // 34:6
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	0x04, 0x8B, 0x0E, 0x07,  // 127:1163

	// Font Data:
	0x00,0x00,0x00,0x00,0xF8,0x0D,	// 33
	0x00,0x00,0x38,0x00,0x00,0x00,0x38,	// 34
	0x00,0x00,0x00,0x02,0x40,0x0A,0xC0,0x07,0x70,0x02,0x40,0x0E,0xE0,0x03,0x50,0x02,0x40,	// 35
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	0x00,0x00,0xF0,0x7F,0x10,0x40,0x10,0x40,0x10,0x40,0x10,0x40,0xF0,0x7F,	// 127
};

/**
	* @brief 	This function sets the coumn start and end address for the OLED
	* @param 	x: Starting column on the OLED
	* 			  y: End column on the OLED
	* @retval   None
	*/
void setColAddress(UI8 x, UI8 y)
{
  ssd1306_WriteCommand(LCD_SET_COL_ADDR); 									   // 0x21 COMMAND
  ssd1306_WriteCommand(x); 				 		 							   // Column start address
  ssd1306_WriteCommand(y);						     						   // Column end address
}

/**
	* @brief 	This function sets the Page start and end address for the OLED
	* @param 	x: Starting page on the OLED
	* 				y: End page on the OLED
	* @retval   None
	*/
void setPageAddress(UI8 x, UI8 y)
{
  ssd1306_WriteCommand(LCD_SET_PAGE_ADDR); 									   // 0x22 COMMAND
  ssd1306_WriteCommand(x); 													   // Start Page address
  ssd1306_WriteCommand(y);													   // End Page address 
}

/**
	* @brief 	This function Writes an SSD1306 specific command
	* @param 	byte: command to send 
	* @retval None
	*/
void ssd1306_WriteCommand(UI8 byte)
{
	UI8 i = 0;
	
	OLED_CS_CLR(); //CS Select OLED
	OLED_DC_CLR();//DC Reset
	for(i=0;i<100;i++) ;
	BB_WriteData(byte);//Send data
	for(i=0;i<100;i++) ;
	OLED_CS_SET(); //CS Unselect OLED
}

/**
	* @brief 	This function sends data to the SSD1306
	* @param 	arr: The array of data to send
	*					bytesToWrite: number of bytes to send
	* @retval   None
	*/
void ssd1306_WriteData1(UI8 arr[], UI16 bytesToWrite)//UI8 byte)
{
	UI16 i,j;
	
	OLED_CS_CLR(); //CS Select OLED
	OLED_DC_SET();//DC Reset

	for(i=0;i<100;i++) ;

	for(j=0; j < bytesToWrite; j++) BB_WriteData(arr[j]);

	for(i=0;i<100;i++) ;
	OLED_CS_SET(); //CS Unselect OLED
}

/**
	* @brief 	This function prepares the datat to be sent to the SSD1306
	* @param 	charArray: raw data to send (no font data yet)
	*					size: size of array
	* 				x: x position on OLED
	*					y: y position on OLED
	* @retval   None
	*/
void TransferBuffer(UI8 charArray[], UI8 size, UI8 x, UI8 y)
{
	UI16 i=0, j=0;  								                                                                                                                                            
	UI8 AllChars[128*2];												   	   //Array 1 transfered to OLED
	UI8 fontJumpArrOffset = 4;
	UI8 byteCount = 0;
	UI8 bytesToRead = 0;
	UI8 currentChar = 0;
	UI8 FontData[4] = {0x00,0x00,0x00,0x00};
	UI16 charStartPoint = 0;
	UI8 AllChars_pos = 0;
	UI8 FirstRow[128];
	UI8 SecondRow[128];
		
	for(i = 0; i<128;i++)
	{
		FirstRow[i] = 0x00;
		SecondRow[i] = 0x00;
	}
	for(i=0; i < sizeof(AllChars); i++) AllChars[i] = 0x00;
	
	//just grab the bytes and start shoving them into the array, 
	//rememeber to keep track of them so we know how many we have, stop when we reach 128
	for(i = 0; i < size; i++)
	{
		currentChar = charArray[i] - 32; //current char - 32 (first char is 32)
		if(currentChar > 96) currentChar = 0;
		for(j = 0; j < 4; j++) //read the font data of the current char
		{
			FontData[j] = CurrentFont[(currentChar * 4) + fontJumpArrOffset + j];
			
		}
		bytesToRead = FontData[2];  //how many bytes are in this char?
		
		//jump table is the following:
		//byte 0 shows the offset of each char (high byte)
		//byte 1 shows the offset of each char  (low byte)
		//byte 2 shows how many bytes are in the character
		//byte 3 shows the width of the char
		charStartPoint = (FontData[0]<<8) + FontData[1]; //calculate where we need to grab from in the array
		charStartPoint += (CurrentFont[3]*4); //there are x chars in the font and each has 4 bytes in jump table
		charStartPoint += 4; //there are 4 chars in the beginning (width height firstChar and numChars)
		
		if((AllChars_pos + (FontData[3])) < (128- x)) //will there be space? /2 because font takes up 2 lines
		{
			for(j=0; j<bytesToRead; j++) //read all the bytes in the arr
			{
				FirstRow[AllChars_pos] = CurrentFont[charStartPoint + j];
				if((j+1) < bytesToRead) SecondRow[AllChars_pos] = CurrentFont[charStartPoint + j + 1];
				else SecondRow[AllChars_pos] = 0x00; //so we dont grab a char we arent meant to
				j++;
				AllChars_pos++;
			}
			if((FontData[3]*2) > bytesToRead) 
			{
				for(j = 0; j < ((FontData[3] * 2) - bytesToRead); j++)
				{
					FirstRow[AllChars_pos] = 0x00;
					SecondRow[AllChars_pos] = 0x00;
					AllChars_pos++; //this is wrong maybe
				}
			}
			byteCount += FontData[3];
		}
		else break; 
		
		charStartPoint = 0;
	}

	j=0;
	for(i = x; i < 128; i++)
	{
		AllChars[i] = FirstRow[j];
		AllChars[128 + i] = SecondRow[j];
		j++;
	}
	setColAddress(0, 127);
	setPageAddress(y, 7);
	ssd1306_WriteData1(AllChars, sizeof(AllChars)); //send data to OLED
}

/**
	* @brief 	This function clears a row on the OLED
	* @param 	line: the line to be cleared
	* @retval None
	*/
void OLED_ClearLine(UI8 line)
{
	UI16 i;
	UI8 BlankLine[256]; //we are actuall clearing two rows (so 128 * 2)
	
	for(i = 0; i < 256; i++) BlankLine[i] = 0x00;
	setColAddress(0, 127);
	setPageAddress(line, 7);
	ssd1306_WriteData1(BlankLine, sizeof(BlankLine));
}

/**
	* @brief 	This function toggles the OLED reset pin, resetting the OLED
	* @param 	None
	* @retval None
	*/
void OLED_Reset(void)
{
	OLED_RST_SET();
	delayus(1);
	OLED_RST_CLR();
	delayus(10);
	OLED_RST_SET();
}

/**
	* @brief 		This function initializes the OLED using recommended values
	* @param 		None
	* @retval   None
	*/
void OLED_init(void)	
{
	OLED_Reset();

    // Recommended initialization sequence
	
  ssd1306_WriteCommand(LCD_DISP_OFF);
  ssd1306_WriteCommand(LCD_SET_COL_LO);
	ssd1306_WriteCommand(LCD_SET_COL_HI);
	ssd1306_WriteCommand(LCD_SET_LINE);
	ssd1306_WriteCommand(LCD_SET_PAGE);
	ssd1306_WriteCommand(LCD_SET_CONTRAST);
	ssd1306_WriteCommand(0xFF);
	ssd1306_WriteCommand(LCD_SET_SEG_REMAP1);
	ssd1306_WriteCommand(LCD_DISP_NOR);
	ssd1306_WriteCommand(LCD_SET_COM);
	ssd1306_WriteCommand(LCD_MULTIPLEX);
	ssd1306_WriteCommand(0x3F);
	ssd1306_WriteCommand(LCD_SET_OFFSET);
	ssd1306_WriteCommand(0x00);
	ssd1306_WriteCommand(LCD_SET_RATIO_OSC);
	ssd1306_WriteCommand(0x80);
	ssd1306_WriteCommand(LCD_SET_CHARGE);
	ssd1306_WriteCommand(0xF1);
	ssd1306_WriteCommand(LCD_MEM_ADDRESSING);
	ssd1306_WriteCommand(0x00);
	ssd1306_WriteCommand(LCD_SET_PADS);
	ssd1306_WriteCommand(0x12);
	ssd1306_WriteCommand(LCD_SET_VCOM);
	ssd1306_WriteCommand(0x40);
	ssd1306_WriteCommand(LCD_CHARGE_PUMP);
	ssd1306_WriteCommand(0x14);
	ssd1306_WriteCommand(LCD_DISP_ON);
}

/**
	* @brief 	This function sets the OLED all pixes on or all off
	* @param 	col: colour, 1 = all  on, 0 = all off
	* @retval None
	*/
void OLED_Clr(UI8 col)
{
	UI16 i = 0;
	UI8 clrArr[1024];
	for(i = 0; i < 1024; i++)
	{
		if(col == 0) clrArr[i] = 0x00; 
		else clrArr[i] = 0xFF; 
	}
	ssd1306_WriteData1(clrArr, sizeof(clrArr));
}



